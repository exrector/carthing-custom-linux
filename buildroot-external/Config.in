## buildroot-external/configs/carthing_superbird_rootfs_defconfig
```kconfig
BR2_aarch64=y
BR2_TOOLCHAIN_BUILDROOT_CXX=y
BR2_INSTALL_LIBSTDCPP=y
BR2_INIT_BUSYBOX=y
BR2_ROOTFS_DEVICE_CREATION_DYNAMIC_DEVTMPFS=y
BR2_TARGET_GENERIC_HOSTNAME="carthing"
BR2_TARGET_GENERIC_GETTY=y
BR2_TARGET_GENERIC_GETTY_PORT="ttyS0"
BR2_GLOBAL_PATCH_DIR="$(BR2_EXTERNAL_CARTHING_CUSTOM_LINUX_PATH)/patches"
BR2_ROOTFS_OVERLAY="$(BR2_EXTERNAL_CARTHING_CUSTOM_LINUX_PATH)/../overlay"
BR2_ROOTFS_POST_BUILD_SCRIPT="$(BR2_EXTERNAL_CARTHING_CUSTOM_LINUX_PATH)/board/carthing/superbird/post-build.sh"
BR2_PACKAGE_BUSYBOX_CONFIG_FRAGMENT_FILES="$(BR2_EXTERNAL_CARTHING_CUSTOM_LINUX_PATH)/board/carthing/superbird/busybox.fragment"
BR2_TARGET_ROOTFS_TAR=y
BR2_TARGET_ROOTFS_EXT2=y
BR2_TARGET_ROOTFS_EXT2_4=y
BR2_TARGET_ROOTFS_EXT2_SIZE="512M"
BR2_PACKAGE_DROPBEAR=y
BR2_PACKAGE_FREETYPE=y
BR2_PACKAGE_IPROUTE2=y
BR2_PACKAGE_LIBGPIOD=y
BR2_PACKAGE_LIBGPIOD_TOOLS=y
BR2_PACKAGE_OPENSSL=y
BR2_PACKAGE_E2FSPROGS=y
BR2_PACKAGE_E2FSPROGS_E2FSCK=y
BR2_PACKAGE_E2FSPROGS_MKE2FS=y
BR2_PACKAGE_PYTHON3=y
BR2_PACKAGE_PYTHON3_PY_PYC=y
BR2_PACKAGE_PYTHON3_BZIP2=y
BR2_PACKAGE_PYTHON3_CODECSCJK=y
BR2_PACKAGE_PYTHON3_CURSES=y
BR2_PACKAGE_PYTHON3_DECIMAL=y
BR2_PACKAGE_PYTHON3_READLINE=y
BR2_PACKAGE_PYTHON3_SSL=y
BR2_PACKAGE_PYTHON3_SQLITE=y
BR2_PACKAGE_PYTHON3_PYEXPAT=y
BR2_PACKAGE_PYTHON3_XZ=y
BR2_PACKAGE_PYTHON3_ZLIB=y
BR2_PACKAGE_PYTHON3_ZSTD=y
BR2_PACKAGE_PYTHON_PIP=y
BR2_PACKAGE_CARTHING_BT_FWLOAD=y
BR2_PACKAGE_CARTHING_BTATTACH_MINI=y
BR2_PACKAGE_PYTHON_CFFI=y
BR2_PACKAGE_PYTHON_CRYPTOGRAPHY=y
BR2_PACKAGE_PYTHON_PILLOW=y
BR2_PACKAGE_PYTHON_SERIAL=y
# sftp-server для dropbear: чинит современный scp (SFTP-протокол) и открывает
# sshfs dev-mount с Mac. Вступит в силу со следующим bake.
BR2_PACKAGE_GESFTPSERVER=y
```

## buildroot-external/package/Config.in
```kconfig
source "$BR2_EXTERNAL_CARTHING_CUSTOM_LINUX_PATH/package/carthing-bt-fwload/Config.in"
source "$BR2_EXTERNAL_CARTHING_CUSTOM_LINUX_PATH/package/carthing-btattach-mini/Config.in"
source "$BR2_EXTERNAL_CARTHING_CUSTOM_LINUX_PATH/package/carthing-mfi-probe/Config.in"
```

## buildroot-external/package/carthing-iap2-agent/Config.in
```kconfig
config BR2_PACKAGE_CARTHING_IAP2_AGENT
	bool "carthing-iap2-agent"
	depends on BR2_PACKAGE_GLIB2
	depends on BR2_PACKAGE_DBUS
	depends on BR2_PACKAGE_BLUEZ5_UTILS
	help
	  Legacy Apple-oriented iAP2/MFi agent path for Car Thing.

	  This is a separate architecture track from the current
	  Bumble/HID/AMS runtime. It requires BlueZ, D-Bus and the
	  inherited apple_mfi kernel/device path.
```

## buildroot-external/package/carthing-mfi-probe/Config.in
```kconfig
config BR2_PACKAGE_CARTHING_MFI_PROBE
	bool "carthing-mfi-probe"
	help
	  Minimal low-level probe for the Apple MFi auth device path.

	  This tool talks directly to /dev/apple_mfi via ioctl and does
	  not depend on BlueZ, bluetoothd, D-Bus, or the old Spotify
	  userspace stack.
```

## experiment/custom-linux-bringup/buildroot-external/package/carthing-bt-fwload/Config.in
```kconfig
config BR2_PACKAGE_CARTHING_BT_FWLOAD
	bool "carthing-bt-fwload"
	help
	  Minimal Broadcom UART firmware loader for Car Thing.

	  This replaces the target-side dependency on BlueZ tooling.
```

## experiment/custom-linux-bringup/buildroot-external/package/carthing-btattach-mini/Config.in
```kconfig
config BR2_PACKAGE_CARTHING_BTATTACH_MINI
	bool "carthing-btattach-mini"
	help
	  Minimal Bluetooth HCI UART attach helper for Car Thing.

	  This keeps the target-side attach path small and avoids a
	  runtime dependency on BlueZ utilities.
```

## experiment/custom-linux-bringup/buildroot-external/package/carthing-iap2-mini/Config.in
```kconfig
config BR2_PACKAGE_CARTHING_IAP2_MINI
	bool "carthing-iap2-mini"
	select BR2_PACKAGE_CARTHING_MFI_PROBE
	help
	  Minimal clean-room iAP2 control/session helper for Car Thing.

	  This keeps only AA00-AA05 auth forwarding plus 1D00 -> 1D01
	  identification in a small standalone binary and does not pull
	  any legacy Spotify userspace back into the image.
```
